#include <VirtualWire.h>

#define HEADER_BYTE 0xAA
#define EMITTER_ID 0x01
#define RECEIVER_ID_1 0x02
#define RECEIVER_ID_2 0x03

const int IMAGE_WIDTH = 32;
const int IMAGE_HEIGHT = 32;
const int TOTAL_PIXELS = IMAGE_WIDTH * IMAGE_HEIGHT;

const int DATA_BYTES_PER_PACKET = 20; // Ahora enviamos 20 bytes por paquete
const int PACKET_SIZE = 1 + 1 + 1 + 1 + DATA_BYTES_PER_PACKET + 1; 
// 25 bytes => Header + Emisor + Receptor + Start Index + Data + Checksum

const uint8_t data_to_send[TOTAL_PIXELS] = {
135, 135, 135, 135, 135, 134, 134, 134, 135, 138, 135, 135, 135, 135, 135, 135,
  135, 135, 135, 135, 141, 165, 190, 189, 161, 137, 133, 136, 149, 152, 149, 136,
  135, 135, 135, 135, 137, 138, 138, 138, 141, 152, 137, 135, 137, 135, 135, 135,
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  221, 207, 148, 185, 186, 180, 173, 135, 113, 43, 86, 43, 114, 129, 128, 123,
};

uint8_t calculateChecksum(uint8_t *data, uint8_t len) {
  uint8_t crc = 0x00;
  for (uint8_t i = 0; i < len; i++) {
    crc ^= data[i];
    for (uint8_t j = 0; j < 8; j++) {
      if (crc & 0x80)
        crc = (crc << 1) ^ 0x07; // Polynomial x^8 + x^2 + x + 1 (0x07)
      else
        crc <<= 1;
    }
  }
  return crc;
}

void setup() {
  vw_set_ptt_inverted(true);
  vw_setup(2000);
  vw_set_tx_pin(2);
  Serial.begin(9600);
  Serial.println("Configurando envio de imagen 20 bytes/paquete...");
}

void loop() {
  uint8_t packet[PACKET_SIZE];

  int total_pixels = TOTAL_PIXELS;
  int packets_to_send = (total_pixels + DATA_BYTES_PER_PACKET - 1) / DATA_BYTES_PER_PACKET; // ceil

  for (int pkt = 0; pkt < packets_to_send; pkt++) {
    packet[0] = HEADER_BYTE;
    packet[1] = EMITTER_ID;
    packet[2] = RECEIVER_ID_2;
    int start_index = pkt * DATA_BYTES_PER_PACKET;
    packet[3] = start_index;

    // Copiar los 20 bytes (o menos si es el último paquete)
    for (int i = 0; i < DATA_BYTES_PER_PACKET; i++) {
      int data_index = start_index + i;
      if (data_index < total_pixels) {
        packet[4 + i] = data_to_send[data_index];
      } else {
        packet[4 + i] = 0; // relleno con 0 si pasamos el total
      }
    }

    // Calcular checksum sobre los primeros 24 bytes
    packet[PACKET_SIZE - 1] = calculateChecksum(packet, PACKET_SIZE - 1);

    vw_send(packet, PACKET_SIZE);
    vw_wait_tx();

    Serial.print("Enviando paquete ");
    Serial.print(pkt + 1);
    Serial.print("/");
    Serial.print(packets_to_send);
    Serial.print("| squence: ");
    Serial.print(start_index);
  
    Serial.print(" | Checksum: 0x");
    Serial.println(packet[PACKET_SIZE - 1], HEX);

    delay(20);
  }

  Serial.println("Envio de imagen completado. Reenviando en 5 segundos...");
  delay(5000);
}